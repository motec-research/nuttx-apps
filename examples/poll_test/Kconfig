## examples/poll_test/Kconfig
```kconfig
#
# For a description of the syntax of this configuration file,
# see the file kconfig-language.txt in the NuttX tools repository.
#

config EXAMPLES_POLL_TEST
	tristate "\"Poll \" example"
	default n
	---help---
		Enable the \"Poll\" example

if EXAMPLES_POLL_TEST

config EXAMPLES_POLL_TEST_PROGNAME
	string "Program name"
	default "poll"
	---help---
		This is the name of the program that will be used when the NSH ELF
		program is installed.

config EXAMPLES_POLL_TEST_PRIORITY
	int "Program task priority"
	default 100

config EXAMPLES_POLL_TEST_STACKSIZE
	int "Program stack size"
	default DEFAULT_TASK_STACKSIZE

endif
```
